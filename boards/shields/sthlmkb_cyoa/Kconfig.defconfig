## boards/shields/sthlmkb_cyoa/Kconfig.defconfig
```kconfig
if SHIELD_STHLMKB_CYOA

# Name must be less than 16 characters long!
config ZMK_KEYBOARD_NAME
    default "sthlmkb_cyoa"

endif
```

## boards/shields/sthlmkb_cyoa/Kconfig.shield
```kconfig
# No whitespace after the comma or in your keyboard name!
config SHIELD_STHLMKB_CYOA
    def_bool $(shields_list_contains,sthlmkb_cyoa)
```
